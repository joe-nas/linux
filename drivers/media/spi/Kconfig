## drivers/media/spi/Kconfig
```kconfig
if SPI
menu "Media SPI Adapters"
	
config CXD2880_SPI_DRV
	tristate "Sony CXD2880 SPI support"
	depends on DVB_CXD2880 && DVB_CORE && SPI
	default m if !MEDIA_SUBDRV_AUTOSELECT
	help
	  Choose if you would like to have SPI interface support for Sony CXD2880.

endmenu

endif
```
